## oe-recipes/conf/layer.conf
```bitbake
BBPATH .= ":${LAYERDIR}"
BBFILES += "${LAYERDIR}/recipes-*/*/*.bb"
BBFILE_COLLECTIONS += "onekvm-video-ax630c"
BBFILE_PATTERN_onekvm-video-ax630c = "^${LAYERDIR}/"
BBFILE_PRIORITY_onekvm-video-ax630c = "7"
LAYERSERIES_COMPAT_onekvm-video-ax630c = "wrynose"
```
